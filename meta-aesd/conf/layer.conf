## meta-aesd/conf/layer.conf
```bitbake
# We have a conf and classes directory, add to BBPATH
BBPATH .= ":${LAYERDIR}"

# We have recipes-* directories, add to BBFILES
BBFILES += "${LAYERDIR}/recipes-*/*/*.bb \
            ${LAYERDIR}/recipes-*/*/*.bbappend"

BBFILE_COLLECTIONS += "meta-aesd"
BBFILE_PATTERN_meta-aesd = "^${LAYERDIR}/"
BBFILE_PRIORITY_meta-aesd = "6"

LAYERDEPENDS_meta-aesd = "core"
LAYERSERIES_COMPAT_meta-aesd = "hardknott kirkstone"
file:///media/usbpc/38013a61-fe9f-4592-96ac-12aaa52dbc26/coursera/assignment-6-paulnwoko/meta-aesd
```
